## conf/layer.conf
```bitbake
# We have a conf and classes directory, add to BBPATH
BBPATH .= ":${LAYERDIR}"

# We have recipes-* directories, add to BBFILES
BBFILES += "${LAYERDIR}/recipes-*/*/*.bb \
            ${LAYERDIR}/recipes-*/*/*.bbappend"

BBFILE_COLLECTIONS += "cy5976-imx8"
BBFILE_PATTERN_cy5976-imx8 = "^${LAYERDIR}/"
BBFILE_PRIORITY_cy5976-imx8 = "6"

LAYERDEPENDS_cy5976-imx8 = "core"
LAYERSERIES_COMPAT_cy5976-imx8 = "scarthgap"
```
